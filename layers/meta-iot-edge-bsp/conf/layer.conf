## layers/meta-iot-edge-bsp/conf/layer.conf
```bitbake
# We have a conf and classes directory, add to BBPATH
BBPATH .= ":${LAYERDIR}"

# We have recipes-* directories, add to BBFILES
BBFILES += "${LAYERDIR}/recipes-*/*/*.bb \
            ${LAYERDIR}/recipes-*/*/*.bbappend"

BBFILE_COLLECTIONS += "meta-iot-edge-bsp"
BBFILE_PATTERN_meta-iot-edge-bsp = "^${LAYERDIR}/"
BBFILE_PRIORITY_meta-iot-edge-bsp = "24"

LAYERDEPENDS_meta-iot-edge-bsp = "core"
LAYERSERIES_COMPAT_meta-iot-edge-bsp = "dunfell"
```

## layers/meta-iot-edge-bsp/conf/machine/iot-edge.conf
```bitbake
#@TYPE: Machine
#@NAME: Toradex Colibri iMX6DL/S
#@SOC: i.MX6DL
#@DESCRIPTION: Machine configuration for Toradex Colibri iMX6 SOM
#@MAINTAINER: Max Krummenacher <max.krummenacher@toradex.com>

MACHINEOVERRIDES =. "mx6:mx6dl:colibri-imx6"

MACHINE_NAME = "IoTEdgeNode"
MACHINE= "iot-edge"

include conf/machine/include/imx-base.inc
include conf/machine/include/tune-cortexa9.inc
include conf/machine/include/colibri-imx6.inc

IMAGE_CLASSES_remove = " image_type_tezi"
IMAGE_FSTYPES_remove = " teziimg"

TEZI_EXTERNAL_KERNEL_DEVICETREE_BOOT = ""
TEZI_EXTERNAL_KERNEL_DEVICETREE_BOOT_use-mainline-bsp = ""
PREFERRED_PROVIDER_virtual/dtb_use-mainline-bsp = ""

IMAGE_BOOT_FILES_append = " boot.scr-${MACHINE};boot.scr"
WKS_FILE_DEPENDS_append = " u-boot-default-script"
PREFERRED_PROVIDER_u-boot-default-script = "u-boot-script"

PREFERRED_PROVIDER_virtual/kernel_use-nxp-bsp ??= "linux-toradex"
EXTERNAL_KERNEL_DEVICETREE = ""
KERNEL_DEVICETREE = "imx6dl-colibri-iot-edge.dtb"
KERNEL_DEVICETREE_use-mainline-bsp = "imx6dl-colibri-iot-edge.dtb"
${KERNEL_PACKAGE_NAME}-devicetree="imx6dl-colibri-iot-edge.dtb" 
#KERNEL_IMAGETYPE = "zImage"
KERNEL_CLASSES = "iot-edge-fitimage"
KERNEL_IMAGETYPES = "fitImage"
# The kernel lives in a seperate FAT partition, don't deploy it in /boot/   
RDEPENDS_${KERNEL_PACKAGE_NAME}-base = ""

PREFERRED_PROVIDER_u-boot ?= "u-boot-toradex"
PREFERRED_PROVIDER_virtual/bootloader ?= "u-boot-toradex"
PREFERRED_PROVIDER_u-boot-fw-utils ?= "u-boot-toradex-fw-utils"
PREFERRED_RPROVIDER_u-boot-fw-utils ?= "u-boot-toradex-fw-utils"
PREFERRED_PROVIDER_u-boot-default-script ?= "u-boot-script-toradex"

SPL_BINARY = "SPL"
UBOOT_CONFIG ??= "spl"
UBOOT_CONFIG[spl] = "colibri_imx6_defconfig,,u-boot.img"
UBOOT_MAKE_TARGET = ""
UBOOT_ENTRYPOINT_use-mainline-bsp = "0x10008000"

INITRAMFS_IMAGE = "image-initramfs"

INITRAMFS_IMAGE_BUNDLE="1"

IMAGE_FSTYPES += "tar.xz"
IMAGE_FSTYPES += "ext4"
INITRAMFS_FSTYPES = "cpio.gz"
# wic support
#IMAGE_BOOT_FILES_append = " boot.scr-${MACHINE};boot.scr"
#WKS_FILE_DEPENDS_append = " u-boot-default-script"
#WKS_FILE = "sdimage-bootpart.wks"

MACHINE_FEATURES += "usbgadget usbhost vfat ext2 wifi bluetooth"
```

## layers/meta-iot-edge/conf/layer.conf
```bitbake
# We have a conf and classes directory, add to BBPATH
BBPATH .= ":${LAYERDIR}"

# We have recipes-* directories, add to BBFILES
BBFILES += "${LAYERDIR}/recipes-*/*/*.bb \
            ${LAYERDIR}/recipes-*/*/*.bbappend"

BBFILE_COLLECTIONS += "meta-iot-edge"
BBFILE_PATTERN_meta-iot-edge = "^${LAYERDIR}/"
BBFILE_PRIORITY_meta-iot-edge = "30"

LAYERDEPENDS_meta-iot-edge = "core"
LAYERSERIES_COMPAT_meta-iot-edge = "dunfell"
```
